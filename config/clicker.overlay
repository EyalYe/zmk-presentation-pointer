#include <input/processors.dtsi>
#include <dt-bindings/zmk/input_transform.h>

&{/gyro_listener} {
    input-processors = <&zip_xy_transform (INPUT_TRANSFORM_X_INVERT | INPUT_TRANSFORM_Y_INVERT)>;
};

&gyro_input {
  scale-div = <100>;
};
