#include <dt-bindings/zmk/matrix_transform.h>

/ {
    chosen {
        zmk,kscan = &default_kscan;
        zmk,matrix_transform = &default_transform;
    };

    default_kscan: kscan {
        compatible = "zmk,kscan-gpio-direct";
        wakeup-source;

        input-gpios
              = <&pro_micro  7 (GPIO_ACTIVE_LOW | GPIO_PULL_UP)>
              , <&pro_micro  8 (GPIO_ACTIVE_LOW | GPIO_PULL_UP)>
              , <&pro_micro  9 (GPIO_ACTIVE_LOW | GPIO_PULL_UP)>
              ;
            };

    default_transform: matrix_transform {
        compatible = "zmk,matrix-transform";
        rows = <1>;
        columns = <3>;

        map = <
            RC(0,0) RC(0,1) RC(0,2) 
        >;
    };
};
