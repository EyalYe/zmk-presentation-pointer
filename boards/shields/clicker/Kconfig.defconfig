## config/west.yml
```yaml
manifest:
  remotes:
    - name: zmkfirmware
      url-base: https://github.com/zmkfirmware
    - name: EyalYe
      url-base: https://github.com/EyalYe
  projects:
    - name: zmk
      remote: zmkfirmware
      revision: main
      import: app/west.yml
    - name: zmk-gyro-pointer
      remote: EyalYe
      revision: main
  self:
    path: config
```
